## conf/layer.conf
```bitbake
# We have a conf and classes directory, add to BBPATH
BBPATH .= ":${LAYERDIR}"

# We have recipes-* directories, add to BBFILES
BBFILES += "${LAYERDIR}/recipes-*/*/*.bb \
            ${LAYERDIR}/recipes-*/*/*.bbappend \
            ${LAYERDIR}/recipes-*/*/*/*.bb \
"

BBFILE_COLLECTIONS += "dashboard"
BBFILE_PATTERN_dashboard = "^${LAYERDIR}/"
BBFILE_PRIORITY_dashboard = "16"

LAYERDEPENDS_meta-env = "core"
LAYERSERIES_COMPAT_dashboard = "kirkstone"

LICENSE_FLAGS_ACCEPTED += "commercial"
```
